## kerrighed/Kconfig.Kerrighed
```kconfig
menu "Cluster support"

config KERRIGHED
	bool "Add the Kerrighed support"
	depends on PREEMPT_NONE && !KEYS
	default y
	select KRG_TOOLS if !KERRIGHED_DEVEL
	select KRG_COMMUNICATION_FRAMEWORK if !KERRIGHED_DEVEL
	select KRG_HOTPLUG if !KERRIGHED_DEVEL
	select KRG_KDDM if !KERRIGHED_DEVEL
	select KRG_CAP if !KERRIGHED_DEVEL
	select KRG_PROCFS if !KERRIGHED_DEVEL
	select KRG_MM if !KERRIGHED_DEVEL
	select KRG_DVFS if !KERRIGHED_DEVEL
	select KRG_FAF if !KERRIGHED_DEVEL
	select KRG_IPC if !KERRIGHED_DEVEL
	select KRG_PROC if !KERRIGHED_DEVEL
	select KRG_EPM if !KERRIGHED_DEVEL
	select KRG_SCHED if !KERRIGHED_DEVEL
	help
	  Say Y if you want to use the Kerrighed features.	

config KERRIGHED_DEVEL
	bool "Allow to build a subset of Kerrighed (!! Kerrighed development only !!)"
	depends on KERRIGHED
	default n
	help
	  The only reason to enable this, is that you intend to port Kerrighed
		on a new architecture.

		Just say N, and forget about it.

config KRG_TOOLS
	bool "Tools"
	depends on KERRIGHED
	help
	  Common library in Kerrighed (without communication)

config KRG_COMMUNICATION_FRAMEWORK
       bool "Communication layer"
       depends on KERRIGHED
       select TIPC
       select KRGRPC
       help
         All-purpose communication layer

config KRG_AUTONODEID
       bool "Set nodeid automatically"
       depends on KRG_COMMUNICATION_FRAMEWORK
       default y
       help
         During the boot, if the IP address is available
	 (dhcp, command line, etc.), this nodeid is set to the less
	 significant byte of the IP address.

	 In order to avoid any headache, be sure that all your nodes are
	 on the same /24 network.

	 This value may be overrided by the kernel boot parameter autonodeid.

	 If unsure, say Y.

config KRG_HOTPLUG
	bool "KerHotplug"
	depends on KERRIGHED
	help
	  Support for nodes management

config KRG_HOTPLUG_ADD
	bool "KerHotplug: Add support"
	depends on KRG_HOTPLUG
	help
	  Support node addition

config KRG_HOTPLUG_DEL
	bool "KerHotplug: removal support"
	depends on KRG_HOTPLUG
	help
	  Support node removal

config KRG_HOTPLUG_XCH
	bool "KerHotplug: replacement support"
	depends on KRG_HOTPLUG
	help
	  Support node replacement

config KRG_DISABLE_HEARTBEAT
       bool "Disable failure detector"
       depends on KRG_HOTPLUG
       help
         If you don't want automatic reconfiguration on a node failure
         just select this option.

config KRG_KDDM
	bool "Kernel Distributed Data Management (KDDM)"
	depends on KRG_COMMUNICATION_FRAMEWORK
	help
	  Cluster wide data management. This is the general purpose
	  mechanism used in Kerrighed to implement distributed
	  services.

	  If unsure, say Y.

config KRG_KDDM_DEBUG
	def_bool KRG_KDDM && KRG_DEBUG

config KRG_CAP
	bool "KerCapabilities"
	depends on KERRIGHED
	help
	  Kerrighed capabilities mechanism.

	  If unsure, say Y.

config KRG_PROCFS
	bool "ProcFS"
	depends on KRG_KDDM && KERRIGHED
	help
	  Global /proc mechanism.

	  If unsure, say Y.

#config KRG_SYNC
#	bool "KerSync"
#	depends on KERRIGHED && KRG_KDDM
#	help
#	  Synchronization library

config KRG_MM
	bool "KerMM"
	depends on KERRIGHED && KRG_KDDM
	help
	  Kerrighed's global memory management

config KRG_DVFS
	bool "Distributed VFS"
#	depends on KRG_MM && KERRIGHED
	depends on KERRIGHED
	help
	  Kerrighed's distributed VFS. This is the Kerrighed basic
	  bloc for distributed file management.

	  If unsure, say Y.

config KRG_FAF
	bool "File access forwarding"
	depends on KERRIGHED && KRG_DVFS
	select EPOLL
	help
	  Enable migration of open files and streams for those which
	  cannot be more efficiently managed by other Kerrighed mechanisms.

	  If unsure, say Y.

config KRG_IPC
	bool "KerIPC"
	depends on KERRIGHED && KRG_KDDM && KRG_MM && IPC_NS
	help
	  Kerrighed's global IPC management

config KRG_PROC
	bool "KerProc"
	depends on KERRIGHED && KRG_KDDM
	help
	  Low-level global process management: global PIDs, syscalls affecting
	  remote tasks (including signals), global proc PID entries.

	  If unsure, say Y.

config KRG_EPM
	bool "KerEPM"
	depends on KERRIGHED && KRG_PROC && KRG_CAP && KRG_MM && (KRG_DVFS || KRG_FAF)
	help
	  Enhanced Process Management:
	    process migration, checkpoint/restart, remote clone.

	  If unsure, say Y.

config KRG_IPC_EPM
       def_bool KRG_IPC && KRG_EPM

menuconfig KRG_SCHED
	bool "Kerrighed support for global scheduling"
	depends on KERRIGHED
	select CONFIGFS_FS
	default y
	help
	  Compile support for global schedulers.

	  This framework allows, at run-time, to build and configure schedulers
	  from third parties hot-pluggable components.

	  If you want automagic loading of scheduler modules while configuring
	  a scheduler, you must select "Automatic module loading" (KMOD) in
	  section "Loadable module support".

	  If unsure, say Y.

if KRG_SCHED

config KRG_SCHED_COMPAT
	bool "Compile components needed to emulate Kerrighed 2.3 hard-coded scheduler"
	depends on KRG_SCHED && KRG_EPM
	default y
	help
	  This option selects the components needed to obtain the same
	  scheduling policy as in Kerrighed 2.3 hard-coded scheduler.
	  See the sample script krg_legacy_scheduler located in Kerrighed's
	  tools to setup this compatible scheduler.

	  If unsure, say Y.

config KRG_SCHED_COMPAT_FORCE
	def_tristate m if KRG_SCHED_COMPAT
	select KRG_SCHED_MIGRATION_PROBE
	select KRG_SCHED_MOSIX_PROBE
	select KRG_SCHED_THRESHOLD_FILTER
	select KRG_SCHED_FREQ_LIMIT_FILTER
	select KRG_SCHED_REMOTE_CACHE_FILTER
	select KRG_SCHED_MOSIX_LOAD_BALANCER
	select KRG_SCHED_ROUND_ROBIN_BALANCER

config KRG_SCHED_CPU_PROBE
	tristate "Sample CPU probe"
	depends on m
	default n
	help
	  Sample CPU probe exposing the CPU load of a node

	  If unsure, say N.

config KRG_SCHED_MEM_PROBE
	tristate "Sample memory probe"
	depends on m
	default n
	help
	  Sample memory probe exposing the total RAM and free RAM available on
	  a node

	  If unsure, say N.

config KRG_SCHED_MIGRATION_PROBE
	tristate "Migration probe"
	depends on KRG_EPM && m
	default n
	select MODULE_HOOK
	help
	  Probe counting the number of ongoing task migrations out of a node
	  and registering the last migration event.

	  If unsure, say N.

config KRG_SCHED_MOSIX_PROBE
	tristate "MOSIX-like CPU probe"
	depends on m
	default n
	select MODULE_HOOK
	help
	  MOSIX-like CPU probe exposing the CPU load of a node as well as the
	  CPU load induced by individual tasks

	  If unsure, say N.

config KRG_SCHED_THRESHOLD_FILTER
	tristate "Threshold filter"
	depends on m
	default n
	help
	  Filter propagating events only if the value exceeds the configured
	  threshold

	  If unsure, say N.

config KRG_SCHED_FREQ_LIMIT_FILTER
	tristate "Frequency limit filter"
	depends on m
	default n
	help
	  Filter propagating events only if, for a configured action monitored,
	  no action is ongoing and the last one occured more than a configured
	  delay before

	  If unsure, say N.

config KRG_SCHED_REMOTE_CACHE_FILTER
	tristate "Remote cache filter"
	depends on m
	default n
	help
	  Filter caching values from the other nodes, at a configured refresh
	  rate

	  If unsure, say N.

config KRG_SCHED_ECHO_POLICY
	tristate "Sample echo policy"
	depends on m
	default n
	help
	  Sample policy that logs the values read on its ports when update
	  notifications are received

	  If unsure, say N.

config KRG_SCHED_MOSIX_LOAD_BALANCER
	tristate "MOSIX-like load balancing policy"
	depends on KRG_EPM && m
	default n
	help
	  Migration-based load balancing policy using simplified algorithms
	  from the CPU load balancing policy found in MOSIX

	  If unsure, say N.

config KRG_SCHED_ROUND_ROBIN_BALANCER
	tristate "Round robin balancing policy"
	depends on m
	default n
	help
	  Policy that selects target nodes in a round robin manner when called

	  If unsure, say N.

endif

config CLUSTER_WIDE_PROC_INFRA
	bool

config CLUSTER_WIDE_PROC
	bool "See Cluster wide stats in /proc"
	depends on KERRIGHED
	default y
	select CLUSTER_WIDE_PROC_INFRA
	help
	  Say yes if you want to see your cluster as a big SMP through the
	  /proc files (meminfo, cpuinfo, etc).
	  
	  If unsure, say Y.

config CLUSTER_WIDE_PROC_CPUINFO
	bool
	depends on KERRIGHED
	default CLUSTER_WIDE_PROC || KRG_PROC
	select CLUSTER_WIDE_PROC_INFRA

config CLUSTER_WIDE_PROC_MEMINFO
	bool
	depends on KERRIGHED
	default CLUSTER_WIDE_PROC || KRG_MM
	select CLUSTER_WIDE_PROC_INFRA

config CLUSTER_WIDE_PROC_LOADAVG
	bool
	depends on KERRIGHED
	default CLUSTER_WIDE_PROC || KRG_PROC
	select CLUSTER_WIDE_PROC_INFRA

config CLUSTER_WIDE_PROC_STAT
	bool
	depends on KERRIGHED
	default CLUSTER_WIDE_PROC || KRG_PROC
	select CLUSTER_WIDE_PROC_INFRA

config CLUSTER_WIDE_PROC_UPTIME
	bool
	depends on KERRIGHED
	default CLUSTER_WIDE_PROC || KRG_PROC
	select CLUSTER_WIDE_PROC_INFRA

config KRG_SYSCALL_EXIT_HOOK
        bool "Syscall exit hook"
	depends on KERRIGHED
	default n

config DEBUG_SEG_FAULT
	bool "Debug seg faults"
	depends on KERRIGHED
	default n

config KRG_DEBUG
	bool "Debug subsystem"
	depends on KERRIGHED
	default n
	select DEBUG_FS
	help
	  Activate Kerrighed's debug subsystem. With this
          subsystem, most Kerrighed debugs can be activated
          dynamically at runtime, after having mounted debugfs. To
          activate debugs for the other subsystems, you will also
          have to activate them in their respective source
          directories.

          This option will increase code size and probably slow
          down the system.

          If unsure, say N.

endmenu
```

## net/krgrpc/Kconfig
```kconfig
#
# Kerrighed RPC Configuration
#

config KRGRPC
	bool "Kerrighed RPC Protocol"
	depends on TIPC
	---help---
	  Cluster-aware Remote Procedure Call (RPC) framework.

	  This protocol is dedicated to distributed operating system services.
	  User-space application are not supposed to use this protocol.

	  For more informations about KRPC, see http://www.kerrighed.org

	  Currently, if you are not planning to run Kerrighed, say N.
```

## net/tipc/Kconfig
```kconfig
#
# TIPC configuration
#

menuconfig TIPC
	tristate "The TIPC Protocol (EXPERIMENTAL)"
	depends on INET && EXPERIMENTAL
	---help---
	  The Transparent Inter Process Communication (TIPC) protocol is
	  specially designed for intra cluster communication. This protocol
	  originates from Ericsson where it has been used in carrier grade
	  cluster applications for many years.
	
	  For more information about TIPC, see http://tipc.sourceforge.net.

	  This protocol support is also available as a module ( = code which
	  can be inserted in and removed from the running kernel whenever you
	  want). The module will be called tipc. If you want to compile it
	  as a module, say M here and read <file:Documentation/kbuild/modules.txt>.

	  If in doubt, say N.

if TIPC

config TIPC_ADVANCED
	bool "Advanced TIPC configuration"
	depends on TIPC
	default n
	help
	  Saying Y here will open some advanced configuration for TIPC. 
	  Most users do not need to bother; if unsure, just say N.

config TIPC_NETID
	int "Network identifier"
	depends on TIPC && TIPC_ADVANCED
	default "4711"
	help
	  Specifies which TIPC network this node belongs to. 
	  Can range from 1 to 9999; default is 4711.
	  
config TIPC_REMOTE_MNG
	bool "Enable remote management"
	depends on TIPC && TIPC_ADVANCED
	default y
	help
 	  Specifies if this node can be remotely managed from another node
	  in the TIPC network.  By default, this capability is enabled.

config TIPC_PORTS
	int "Maximum number of ports in own node"
	depends on TIPC && TIPC_ADVANCED
	default "8191"
	help
	  Specifies how many ports can be supported by this node. 
	  Can range from 127 to 65536; default is 8191. 

	  Setting this to a smaller value saves some memory; 
	  setting it to a higher value allows more ports.

config TIPC_NODES
	int "Maximum number of nodes in own cluster"
	depends on TIPC && TIPC_ADVANCED
	default "255"
	help
	  Specifies how many nodes can be supported in own TIPC cluster. 
	  Can range from 8 to 4095 nodes; default is 255. 

	  Setting this to a smaller value saves some memory; 
	  setting it to a higher value allows more nodes.

config TIPC_CLUSTERS
	int "Maximum number of clusters in own zone"
	depends on TIPC && TIPC_ADVANCED
	default "8"
	help
	  Specifies how many clusters can be supported in own TIPC zone. 
	  Can range from 1 to 4095 clusters; default is 8. 

	  Setting this to a smaller value saves some memory; 
	  setting it to a higher value allows for more clusters.

config TIPC_ZONES
	int "Maximum number of zones in own network"
	depends on TIPC && TIPC_ADVANCED
	default "4"
	help
	  Specifies how many zones can be supported in own TIPC network. 
	  Can range from 1 to 255 zones; default is 4. 

	  Setting this to a smaller value saves some memory; 
	  setting it to a higher value allows for more zones.

config TIPC_REMOTES
	int "Maximum number of neighbor nodes in other clusters"
	depends on TIPC && TIPC_ADVANCED
	default "8"
	help
	  Specifies how many nodes in other clusters this node can establish
	  links to.  Can range from 0 to 255 nodes; default is 8. 

	  Setting this to a smaller value saves some memory; 
	  setting it to a higher value allows more inter-cluster links.

config TIPC_PUBL
	int "Maximum number of name publications by own node"
	depends on TIPC && TIPC_ADVANCED
	default "10000"
	help
	  Specifies how many concurrent name publications this node can issue.
	  Can range from 1 to 65535 publications; default is 10000. 

	  Setting this to a smaller value saves some memory; 
	  setting it to a higher value allows more name publications.

config TIPC_SUBSCR
	int "Maximum number of name subscriptions by own node"
	depends on TIPC && TIPC_ADVANCED
	default "2000"
	help
	  Specifies how many concurrent name subscriptions this node can handle.
	  Can range from 1 to 65535 subscriptions; default is 2000. 

	  Setting this to a smaller value saves some memory; 
	  setting it to a higher value allows more name subscriptions.

config TIPC_LOG
	int "Size of log buffer"
	depends on TIPC && TIPC_ADVANCED
	default 0
	help
 	  Size (in bytes) of TIPC's internal log buffer, which records the
	  occurrence of significant events.  Can range from 0 to 32768 bytes;
	  default is 0.

	  There is no need to enable the log buffer unless the node will be
	  managed remotely via TIPC.

config TIPC_UNICLUSTER_FRIENDLY
	bool "Inter-operate with uni-cluster nodes"
	depends on TIPC
	default y
	help
 	  This allows TIPC to communicate with nodes in its cluster that
	  pre-date the introduction of multi-cluster TIPC support (that is,
	  nodes running TIPC 1.6 or earlier).

config TIPC_MULTIPLE_LINKS
	bool "Enable redundant link support"
	depends on TIPC
	default y
	help
 	  This allows TIPC to establish multiple links to neighboring nodes
	  wherever possible.  In the event of link failure TIPC will redirect
	  messages on that link to an alternate link if one is available.

config TIPC_CONFIG_SERVICE
	bool "Enable configuration service"
	depends on TIPC
	default y
	help
 	  This allows TIPC to be dynamically configured and monitored
	  using the tipc-config tool.

config TIPC_SOCKET_API
	bool "Enable socket support"
	depends on TIPC
	default y
	help
 	  This allows TIPC to support sockets of the AF_TIPC address family.

config TIPC_SYSTEM_MSGS
	bool "Enable system messages"
	depends on TIPC
	default y
	help
 	  This allows TIPC to record the occurrence of significant events
	  in the system log (and, if enabled, TIPC's own internal log buffer).
	  These events include errors, warnings, and informatory notices, and
	  can be useful in monitoring the operation of TIPC and in detecting
	  and diagnosing problems.

config TIPC_DEBUG
	bool "Enable debug messages"
	depends on TIPC
	default n
	help
 	  This enables debugging of TIPC.

	  Only say Y here if you are having trouble with TIPC.  It will
	  enable the display of detailed information about what is going on.

endif # TIPC
```
